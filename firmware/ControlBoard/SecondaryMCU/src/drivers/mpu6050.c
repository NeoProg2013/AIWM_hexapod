/* ================================================================================================ *
| FIFO packet structure:
| [QUAT W][      ][QUAT X][      ][QUAT Y][      ][QUAT Z][      ]
|  00  01  02  03  04  05  06  07  08  09  10  11  12  13  14  15      
| [GYRO X][GYRO X][GYRO Y][GYRO Y][GYRO Z][GYRO Z][      ]
|  16  17  18  19  20  21  22  23  24  25  28  27  28  29  
* ================================================================================================ */
#include <stdbool.h>
#include <string.h>
#include <math.h>
#include "project_base.h"
#include "i2c1.h"
#include "mpu6050.h"
#include "systimer.h"
#define MPU6050_I2C_ADDRESS                             (0x68 << 1)
#define CHIP_ID                                         (0x34)

#define FIFO_PACKET_SIZE                                (30)        // bytes
#define M_PI                                            (3.14159265f)


static const uint8_t DMP_MEMORY_BINARY[] = {
    // bank 0, 256 bytes
    0xFB,0x00,0x00,0x3E,0x00,0x0B,0x00,0x36,0x00,0x01,0x00,0x02,0x00,0x03,0x00,0x00,
    0x00,0x65,0x00,0x54,0xFF,0xEF,0x00,0x00,0xFA,0x80,0x00,0x0B,0x12,0x82,0x00,0x01,
    0x00,0x02,0x00,0x00,0x00,0x00,0x00,0x00,0x00,0x00,0x00,0x00,0x00,0x00,0x00,0x00,
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    0xFF,0xE6,0x80,0x79,0x02,0x00,0x00,0x00,0x00,0x00,0xD0,0xD6,0x00,0x00,0x27,0x10,
    // bank 1, 256 bytes
    0xFB,0x00,0x00,0x00,0x40,0x00,0x00,0x00,0x00,0x00,0x00,0x00,0x00,0x00,0x00,0x00,
    0x00,0x00,0x00,0x01,0x00,0x00,0x00,0x00,0x00,0x00,0x01,0x00,0x01,0x00,0x00,0x00,
    0x00,0x00,0xFA,0x36,0xFF,0xBC,0x30,0x8E,0x00,0x05,0xFB,0xF0,0xFF,0xD9,0x5B,0xC8,
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    0x00,0x00,0x25,0x4D,0x00,0x2F,0x70,0x6D,0x00,0x00,0x05,0xAE,0x00,0x0C,0x02,0xD0,
    // bank 2, 256 bytes
    0x00,0x00,0x00,0x00,0x00,0x65,0x00,0x54,0xFF,0xEF,0x00,0x00,0x00,0x00,0x00,0x00,
    0x00,0x00,0x01,0x00,0x00,0x44,0x00,0x00,0x00,0x00,0x0C,0x00,0x00,0x00,0x01,0x00,
    0x00,0x00,0x00,0x00,0x00,0x65,0x00,0x00,0x00,0x54,0x00,0x00,0xFF,0xEF,0x00,0x00,
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    0x00,0x00,0x00,0x00,0x00,0x00,0x00,0x00,0x00,0x00,0x00,0x00,0x00,0x00,0x00,0x00,
    // bank 3, 256 bytes
    0xD8,0xDC,0xBA,0xA2,0xF1,0xDE,0xB2,0xB8,0xB4,0xA8,0x81,0x91,0xF7,0x4A,0x90,0x7F,
    0x91,0x6A,0xF3,0xF9,0xDB,0xA8,0xF9,0xB0,0xBA,0xA0,0x80,0xF2,0xCE,0x81,0xF3,0xC2,
    0xF1,0xC1,0xF2,0xC3,0xF3,0xCC,0xA2,0xB2,0x80,0xF1,0xC6,0xD8,0x80,0xBA,0xA7,0xDF,
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    0xB8,0xA2,0xDF,0xDF,0xDF,0xA3,0xDF,0xDF,0xDF,0xD8,0xD8,0xF1,0xB8,0xA8,0xB2,0x86,
    // bank 4, 256 bytes
    0xB4,0x98,0x0D,0x35,0x5D,0xB8,0xAA,0x98,0xB0,0x87,0x2D,0x35,0x3D,0xB2,0xB6,0xBA,
    0xAF,0x8C,0x96,0x19,0x8F,0x9F,0xA7,0x0E,0x16,0x1E,0xB4,0x9A,0xB8,0xAA,0x87,0x2C,
    0x54,0x7C,0xB9,0xA3,0xDE,0xDF,0xDF,0xA3,0xB1,0x80,0xF2,0xC4,0xCD,0xC9,0xF1,0xB8,
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    0xC8,0x9F,0x12,0x9E,0xF3,0x15,0xA8,0xDA,0x12,0x10,0xD8,0xF1,0xAF,0xC8,0x97,0x87,
    // bank 5, 256 bytes
    0x34,0xB5,0xB9,0x94,0xA4,0x21,0xF3,0xD9,0x22,0xD8,0xF2,0x2D,0xF3,0xD9,0x2A,0xD8,
    0xF2,0x35,0xF3,0xD9,0x32,0xD8,0x81,0xA4,0x60,0x60,0x61,0xD9,0x61,0xD8,0x6C,0x68,
    0x69,0xD9,0x69,0xD8,0x74,0x70,0x71,0xD9,0x71,0xD8,0xB1,0xA3,0x84,0x19,0x3D,0x5D,
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    0x8A,0x64,0x48,0x31,0x8B,0x30,0x49,0x60,0xA5,0x88,0x20,0x09,0x71,0x58,0x44,0x68,
    // bank 6, 256 bytes
    0x11,0x39,0x64,0x49,0x30,0x19,0xF1,0xAC,0x00,0x2C,0x54,0x7C,0xF0,0x8C,0xA8,0x04,
    0x28,0x50,0x78,0xF1,0x88,0x97,0x26,0xA8,0x59,0x98,0xAC,0x8C,0x02,0x26,0x46,0x66,
    0xF0,0x89,0x9C,0xA8,0x29,0x51,0x79,0x24,0x70,0x59,0x44,0x69,0x38,0x64,0x48,0x31,
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    0xAC,0x91,0x2C,0x4C,0x6C,0x8A,0x9B,0x2D,0xD9,0xD8,0xD8,0x51,0xD9,0xD8,0xD8,0x79,
    // bank 7, 138 bytes (remainder)
    0xD9,0xD8,0xD8,0xF1,0x9E,0x88,0xA3,0x31,0xDA,0xD8,0xD8,0x91,0x2D,0xD9,0x28,0xD8,
    0x4D,0xD9,0x48,0xD8,0x6D,0xD9,0x68,0xD8,0xB1,0x83,0x93,0x35,0x3D,0x80,0x25,0xDA,
    0xD8,0xD8,0x85,0x69,0xDA,0xD8,0xD8,0xB4,0x93,0x81,0xA3,0x28,0x34,0x3C,0xF3,0xAB,
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    0xB9,0xA7,0xF1,0x26,0x26,0x26,0xD8,0xD8,0xFF
};

static const uint8_t DMP_CONFIG_BINARY[] = {
    // BANK OFFSET LENGTH [DATA]
    0x03,0x7B,0x03,0x4C,0xCD,0x6C,                    // FCFG_1  inv_set_gyro_calibration
    0x03,0xAB,0x03,0x36,0x56,0x76,                    // FCFG_3  inv_set_gyro_calibration
    0x00,0x68,0x04,0x02,0xCB,0x47,0xA2,               // D_0_104 inv_set_gyro_calibration
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    0x02,0x16,0x02,0x00,0x00                          // D_0_22  inv_set_fifo_rate 
};

#define REG_SMPLRT_DIV                      (0x19)
#define REG_CONFIG                          (0x1A)
#define REG_GYRO_CONFIG                     (0x1B)
#define REG_ACCEL_CONFIG                    (0x1C)
#define REG_INT_CONFIG                      (0x37)
#define REG_INT_ENABLE                      (0x38)
#define REG_USER_CTRL                       (0x6A)
#define REG_PWR_MGMT_1                      (0x6B)
#define REG_BANK_SEL                        (0x6D)   
#define REG_MEM_START_ADDR                  (0x6E)
#define REG_MEM_R_W                         (0x6F)
#define REG_DMP_CFG_1                       (0x70)
#define REG_DMP_CFG_2                       (0x71)
#define REG_FIFO_COUNTH                     (0x72)
#define REG_FIFO_R_W                        (0x74)
#define REG_WHO_AM_I                        (0x75)

#define CFG_DLPF_CFG_MASK                   (0x07)
#define DLPF_BW_256                         (0x00)
#define DLPF_BW_188                         (0x01)
#define DLPF_BW_98                          (0x02)
#define DLPF_BW_42                          (0x03)
#define DLPF_BW_20                          (0x04)
#define DLPF_BW_10                          (0x05)
#define DLPF_BW_5                           (0x06)

#define PWR1_CLKSEL_MASK                    (0x07)
#define CLOCK_INTERNAL                      (0x00)
#define CLOCK_PLL_XGYRO                     (0x01)
#define CLOCK_PLL_YGYRO                     (0x02)
#define CLOCK_PLL_ZGYRO                     (0x03)
#define CLOCK_PLL_EXT32K                    (0x04)
#define CLOCK_PLL_EXT19M                    (0x05)

#define ACONFIG_AFS_SEL_MASK                (0x18)
#define ACCEL_AFS_2                         (0x00)
#define ACCEL_AFS_4                         (0x08)
#define ACCEL_AFS_8                         (0x10)
#define ACCEL_AFS_16                        (0x18)

#define GCONFIG_FS_SEL_MASK                 (0x18)
#define GYRO_FS_250                         (0x00)
#define GYRO_FS_500                         (0x08)
#define GYRO_FS_1000                        (0x10)
#define GYRO_FS_2000                        (0x18)

#define USERCTRL_DMP_EN_MASK                (0x80)
#define USERCTRL_DMP_EN                     (0x80)
#define USERCTRL_DMP_DIS                    (0x00)

#define USERCTRL_FIFO_EN_MASK               (0x40)
#define USERCTRL_FIFO_EN                    (0x40)
#define USERCTRL_FIFO_DIS                   (0x00)

#define USERCTRL_FIFO_RESET_MASK            (0x04)
#define USERCTRL_FIFO_RESET                 (0x04)

#define PWR1_DEVICE_RESET_MASK              (0x80)
#define PWR1_DEVICE_RESET                   (0x80)

#define PWR1_SLEEP_MASK                     (0x40)
#define PWR1_SLEEP_EN                       (0x40)
#define PWR1_SLEEP_DIS                      (0x00)


static bool write_memory_block(const uint8_t* data, uint32_t address, uint32_t bank, uint32_t data_size);
static bool write_dmp_config();



//  ***************************************************************************
/// @brief  MPU6050 initialization
/// @return true - success, false - i2c error
//  ***************************************************************************
bool mpu6050_init(void) {
    uint8_t reg = 0; // Check device ID
    if (!i2c1_read(MPU6050_I2C_ADDRESS, REG_WHO_AM_I, 1, &reg, 1)) return false;
    if ((reg >> 1) != CHIP_ID) {
        return false;
    }

    // Software reset
    if (!i2c1_read(MPU6050_I2C_ADDRESS, REG_PWR_MGMT_1, 1, &reg, 1)) return false;
    reg &= ~PWR1_DEVICE_RESET_MASK;
    reg |= PWR1_DEVICE_RESET;
    if (!i2c1_write(MPU6050_I2C_ADDRESS, REG_PWR_MGMT_1, 1, &reg, 1)) return false;
    delay_ms(30);

    // Disable sleep mode
    if (!i2c1_read(MPU6050_I2C_ADDRESS, REG_PWR_MGMT_1, 1, &reg, 1)) return false;
    reg &= ~PWR1_SLEEP_MASK;
    reg |= PWR1_SLEEP_DIS;
    if (!i2c1_write(MPU6050_I2C_ADDRESS, REG_PWR_MGMT_1, 1, &reg, 1)) return false;

    // Load DMP firmware (reverse engineering)
    if (!write_memory_block(DMP_MEMORY_BINARY, 0, 0, sizeof(DMP_MEMORY_BINARY))) return false;

    // Load DMP configuration (reverse engineering)
    if (!write_dmp_config()) return false;

    // Set clock source
    if (!i2c1_read(MPU6050_I2C_ADDRESS, REG_PWR_MGMT_1, 1, &reg, 1)) return false;
    reg &= ~PWR1_CLKSEL_MASK;
    reg |= CLOCK_PLL_XGYRO;
    if (!i2c1_write(MPU6050_I2C_ADDRESS, REG_PWR_MGMT_1, 1, &reg, 1)) return false;

    // Setup internal low pass filter
    if (!i2c1_read(MPU6050_I2C_ADDRESS, REG_CONFIG, 1, &reg, 1)) return false;
    reg &= ~CFG_DLPF_CFG_MASK;
    reg |= DLPF_BW_42;
    if (!i2c1_write(MPU6050_I2C_ADDRESS, REG_CONFIG, 1, &reg, 1)) return false;

    // Set sample rate divisor (1khz / (1 + 4) = 200Hz)
    reg = 0x04;
    if (!i2c1_write(MPU6050_I2C_ADDRESS, REG_SMPLRT_DIV, 1, &reg, 1)) return false;

    // Set accel range +/- 2g
    if (!i2c1_read(MPU6050_I2C_ADDRESS, REG_ACCEL_CONFIG, 1, &reg, 1)) return false;
    reg &= ~ACONFIG_AFS_SEL_MASK;
    reg |= ACCEL_AFS_2;
    if (!i2c1_write(MPU6050_I2C_ADDRESS, REG_ACCEL_CONFIG, 1, &reg, 1)) return false;

    // Set gyro range +/- 2000
    if (!i2c1_read(MPU6050_I2C_ADDRESS, REG_GYRO_CONFIG, 1, &reg, 1)) return false;
    reg &= ~GCONFIG_FS_SEL_MASK;
    reg |= GYRO_FS_2000;
    if (!i2c1_write(MPU6050_I2C_ADDRESS, REG_GYRO_CONFIG, 1, &reg, 1)) return false;

    // Set DMP configuration registers (reverse engineering)
    reg = 0x03;
    if (!i2c1_write(MPU6050_I2C_ADDRESS, REG_DMP_CFG_1, 1, &reg, 1)) return false;
    reg = 0x00;
    if (!i2c1_write(MPU6050_I2C_ADDRESS, REG_DMP_CFG_2, 1, &reg, 1)) return false;

    // Disable FIFO and DMP
    reg = 0x00;
    if (!i2c1_write(MPU6050_I2C_ADDRESS, REG_USER_CTRL, 1, &reg, 1)) return false;

    // Disable all IRQ
    reg = 0x00;
    if (!i2c1_write(MPU6050_I2C_ADDRESS, REG_INT_ENABLE, 1, &reg, 1)) return false;
    
    return true;
}

//  ***************************************************************************
/// @brief  MPU6050 start DMP
/// @return true - success, false - i2c error
//  ***************************************************************************
bool mpu6050_start(void) {
    uint8_t reg = 0x0C; // Reset FIFO and DMP
    if (!i2c1_write(MPU6050_I2C_ADDRESS, REG_USER_CTRL, 1, &reg, 1)) return false;

    reg = 0xC0; // Enable FIFO and DMP
    if (!i2c1_write(MPU6050_I2C_ADDRESS, REG_USER_CTRL, 1, &reg, 1)) return false;
    
    return true;
}

//  ***************************************************************************
/// @brief  MPU6050 stop DMP
/// @return true - success, false - i2c error
//  ***************************************************************************
bool mpu6050_stop(void) {
    uint8_t reg = 0x00; // Disable FIFO and DMP
    if (!i2c1_write(MPU6050_I2C_ADDRESS, REG_USER_CTRL, 1, &reg, 1)) return false;

    reg = 0x0C; // Reset FIFO and DMP
    if (!i2c1_write(MPU6050_I2C_ADDRESS, REG_USER_CTRL, 1, &reg, 1)) return false;

    return true;
}

//  ***************************************************************************
/// @brief  Check data ready
/// @param  is_ready: true - data is ready, false - no
/// @return true - check success, false - i2c error
//  ***************************************************************************
bool mpu6050_is_data_ready(bool* is_ready) {
    *is_ready = false;
    
    uint8_t buffer[2] = { 0 }; // Get FIFO buffer size
    if (!i2c1_read(MPU6050_I2C_ADDRESS, REG_FIFO_COUNTH, 1, buffer, 2)) return false;
    uint32_t fifo_bytes_count = ((uint16_t)buffer[0] << 8) | buffer[1];
    
    // Check FIFO buffer size
    if (fifo_bytes_count == 0) {
        return true;
    }
    if ((fifo_bytes_count % FIFO_PACKET_SIZE) != 0) { // Overrun
        uint8_t reg = 0;
        if (!i2c1_read(MPU6050_I2C_ADDRESS, REG_USER_CTRL, 1, &reg, 1)) return false;
        reg &= ~USERCTRL_FIFO_RESET_MASK;
        reg |= USERCTRL_FIFO_RESET;
        i2c1_write(MPU6050_I2C_ADDRESS, REG_USER_CTRL, 1, &reg, 1);
        return true;
    }
    *is_ready = true;
    return true;
}

//  ***************************************************************************
/// @brief  Read data
/// @param  xy_angles: buffer for XY angles
/// @return true - read success, false - i2c error
//  ***************************************************************************
bool mpu6050_read_data(float* xy_angles) {
    uint8_t data[32] = {0};
    while (true) { // Read last data from FIFO buffer
        bool is_ready = false;
        if (!mpu6050_is_data_ready(&is_ready)) return false;
        
        if (!is_ready) {
            break;
        }
        
        if (!i2c1_read(MPU6050_I2C_ADDRESS, REG_FIFO_R_W, 1, data, FIFO_PACKET_SIZE)) return false;
    }
    
    // Parse quaternions
    int16_t raw_q[4] = { 0 };
    raw_q[0] = ((int16_t)data[0]  << 8) | data[1];
    raw_q[1] = ((int16_t)data[4]  << 8) | data[5];
    raw_q[2] = ((int16_t)data[8]  << 8) | data[9];
    raw_q[3] = ((int16_t)data[12] << 8) | data[13];

    // Scaling
    float Q[4] = { 0 };    // WXYZ
    Q[0] = raw_q[0] / 16384.0f;
    Q[1] = raw_q[1] / 16384.0f;
    Q[2] = raw_q[2] / 16384.0f;
    Q[3] = raw_q[3] / 16384.0f;

    // Euler angles
    xy_angles[0] = atan2(2.0f * (Q[0] * Q[1] + Q[2] * Q[3]), 1.0f - 2.0f * (Q[1] * Q[1] + Q[2] * Q[2]));
    xy_angles[1] = asin(2.0f * (Q[0] * Q[2] - Q[3] * Q[1]));
    xy_angles[0] *= 180.0f / M_PI;
    xy_angles[1] *= 180.0f / M_PI;
    
    return true;
}






#define MAX_BLOCK_SIZE            (64)
//  ***************************************************************************
/// @brief  Write memory block to MPU6050
/// @param  data: data for write
/// @param  address: destination address
/// @param  bank: bank number
/// @param  data_size: bytes count for write
/// @return true - success, false - i2c error
//  ***************************************************************************
static bool write_memory_block(const uint8_t* data, uint32_t address, uint32_t bank, uint32_t data_size)  {
    
    for (uint32_t i = 0; i < data_size; i += MAX_BLOCK_SIZE) {

        // Calculate block size for write
        uint32_t block_size = MAX_BLOCK_SIZE;
        if (i + block_size > data_size) {
            block_size = data_size - i;
        }
        if (block_size > 256 - address) {
            block_size = 256 - address;
        }

        // Read block from FLASH
        uint8_t prog_buffer[MAX_BLOCK_SIZE] = { 0 };
        for (uint32_t j = 0; j < block_size; ++j) {
            prog_buffer[j] = *(data + i + j);
        }

        //
        // Write data
        //

        // Set data bank 
        uint8_t reg = bank & 0x1F;
        if (!i2c1_write(MPU6050_I2C_ADDRESS, REG_BANK_SEL, 1, &reg, 1)) return false;

        // Set start address
        reg = address;
        if (!i2c1_write(MPU6050_I2C_ADDRESS, REG_MEM_START_ADDR, 1, &reg, 1)) return false;
 
        // Write block to MPU6050
        if (!i2c1_write(MPU6050_I2C_ADDRESS, REG_MEM_R_W, 1, prog_buffer, block_size)) return false;
    
        //
        // Verify data
        //

        // Set data bank 
        reg = bank & 0x1F;
        if (!i2c1_write(MPU6050_I2C_ADDRESS, REG_BANK_SEL, 1, &reg, 1)) return false;

        // Set start address
        reg = address;
        if (!i2c1_write(MPU6050_I2C_ADDRESS, REG_MEM_START_ADDR, 1, &reg, 1)) return false;
        
        // Check written block
        uint8_t verify_buffer[MAX_BLOCK_SIZE] = { 0 };
        if (!i2c1_read(MPU6050_I2C_ADDRESS, REG_MEM_R_W, 1, verify_buffer, block_size)) return false;
        if (memcmp(prog_buffer, verify_buffer, block_size) != 0) {
            return false;
        }

        // Address offset
        address += MAX_BLOCK_SIZE;
        if (address == 256) {
            bank++;
            address = 0;
        }
    }
    return true;
}

//  ***************************************************************************
/// @brief  Write DMP configuration
/// @return true - success, false - i2c error
//  ***************************************************************************
static bool write_dmp_config(void) {
    // [bank] [offset] [length] [byte[0], byte[1], ..., byte[length]]
    const uint8_t* data = DMP_CONFIG_BINARY;
    for (uint32_t i = 0; i < sizeof(DMP_CONFIG_BINARY); /* NONE */) {
        uint8_t bank   = *(data + i++);
        uint8_t offset = *(data + i++);
        uint8_t length = *(data + i++);
        if (!write_memory_block(data + i, offset, bank, length)) return false;
        i += length;
    }
    return true;
}
